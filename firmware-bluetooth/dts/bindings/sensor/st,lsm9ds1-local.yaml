## firmware-bluetooth/dts/bindings/sensor/st,lsm9ds1-local.yaml
```yaml
description: Local LSM9DS1 accelerometer and gyroscope node

compatible: "st,lsm9ds1-local"

include: i2c-device.yaml
```

## firmware-bluetooth/dts/bindings/sensor/st,lsm9ds1-mag-local.yaml
```yaml
description: Local LSM9DS1 magnetometer node

compatible: "st,lsm9ds1-mag-local"

include: i2c-device.yaml
```
